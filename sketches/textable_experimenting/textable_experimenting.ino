/**
 * @file textable_experimenting.ino
 * @author your name (you@domain.com)
 * @version 0.1
 * @date 2023-11-14
 * 
 * @brief UTFT library source: http://www.rinkydinkelectronics.com/library.php?id=51
 * @brief URTOUCH library source: http://www.rinkydinkelectronics.com/library.php?id=92 // doesnt currently have touch
 * @brief 
 * 
 * @copyright Copyright (c) 2023
 * 
 */

// #include <cstdint>
#include <UTFT.h>
// #include <string>
// #include <string>



#define BUTTON_PIN_UPWARD 4
#define BUTTON_PIN_DOWNER 2
#define BUTTON_PIN_LEFTER 3
#define BUTTON_PIN_RIGHTR 5

#define BUTTON_PIN_A 6
#define BUTTON_PIN_B 7

#define TFTLCD_PIN_RS 38
#define TFTLCD_PIN_WR 39
#define TFTLCD_PIN_CS 40
#define TFTLCD_PIN_RST 41

#define LOOP_SNOOZE_TIME 10

#define TEXT_HEIGHT 12



#define ASCII_WHITESPACECHAR 0x20

#define ASCII_RANGESTART_PLAINTEXT 0x30
#define ASCII_RANGESTART_DIGIT 0x30
#define ASCII_RANGESTART_UPPER 0x41
#define ASCII_RANGESTART_LOWER 0x61

#define ASCII_RANGESIZE_DIGIT 0xa
#define ASCII_RANGESIZE_ALPHA 0x1a

#define BITMASK_HALFBYTE_LOWER 0xf
#define BITMASK_HALFBYTE_UPPER 0xf0
#define BITMASK_BYTE 0xff

// screen instance thinger
//  uses pins for the screen
UTFT screenInstance(
  ILI9486,
  TFTLCD_PIN_RS,
  TFTLCD_PIN_WR,
  TFTLCD_PIN_CS,
  TFTLCD_PIN_RST
);

// screen size stuff
static const unsigned SCREEN_WIDTH = 480, SCREEN_HEIGHT = 320;

// mouse positioning
int mouseX = SCREEN_WIDTH/2, mouseY = SCREEN_HEIGHT/2;

#define MOUSEMODE_NONE 0
#define MOUSEMODE_DRAW 1
#define MOUSEMODE_CLEAR 2
// mouse mode var
int mouseMode = MOUSEMODE_NONE;

// Declare which fonts we will be using
extern uint8_t SmallFont[];
extern uint8_t BigFont[];



// SmallishFont.c 
// Font Size	: 8x12
// Memory usage	: 1144 bytes
// # characters	: 95

uint8_t SmallishFont[] = {
//x_size,	y_size,	offset,	numchars
//     8      12      32        95
    0x0C,   0x0C,   0x20,     0x5F,
  0x00,0x00,0x00,0x00,0x00,0x00,0x00,0x00,0x00,0x00,0x00,0x00, // <Space>
  0x00,0x00,0x20,0x20,0x20,0x20,0x20,0x20,0x00,0x20,0x00,0x00, // !
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  0x40,0xA4,0x18,0x00,0x00,0x00,0x00,0x00,0x00,0x00,0x00,0x00, // ~
};  



// BigFont.c (C)2010 by Henning Karlsen
// Font Size	: 16x16
// Memory usage	: 3044 bytes
// # characters	: 95

uint8_t BiggerFont[] = {
//x_size,	y_size,	offset,	numchars
//  16    16    32    95
  0x10, 0x10, 0x20, 0x5F,
  0x00,0x00,0x00,0x00,0x00,0x00,0x00,0x00,0x00,0x00,0x00,0x00,0x00,0x00,0x00,0x00,0x00,0x00,0x00,0x00,0x00,0x00,0x00,0x00,0x00,0x00,0x00,0x00,0x00,0x00,0x00,0x00, //  <Space>
  0x00,0x00,0x00,0x00,0x07,0x00,0x0F,0x80,0x0F,0x80,0x0F,0x80,0x0F,0x80,0x0F,0x80,0x07,0x00,0x07,0x00,0x00,0x00,0x00,0x00,0x07,0x00,0x07,0x00,0x07,0x00,0x00,0x00, // !
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  0x00,0x00,0x00,0x00,0x1F,0x1C,0x3B,0x9C,0x39,0xDC,0x38,0xF8,0x00,0x00,0x00,0x00,0x00,0x00,0x00,0x00,0x00,0x00,0x00,0x00,0x00,0x00,0x00,0x00,0x00,0x00,0x00,0x00  // ~
}; 



#define DISPLAYING_CELAENA 0
#define DISPLAYING_EMBER 1
unsigned displayingCharacter = DISPLAYING_CELAENA;

#define ABILITY_COUNT 6
#define SKILL_COUNT 18

#define CELAENA_CHAR_NAME " CELAENA (lvl 5) "

#define CELAENA_ABILITY_TEXT_STR "[ 9] STR(-1)"
#define CELAENA_ABILITY_TEXT_DEX "[16] DEX(+3)"
#define CELAENA_ABILITY_TEXT_CON "[13] CON(+1)"
#define CELAENA_ABILITY_TEXT_INT "[15] INT(+2)"
#define CELAENA_ABILITY_TEXT_WIS "[12] WIS(+1)"
#define CELAENA_ABILITY_TEXT_CHA "[18] CHA(+4)"

// STR skills
#define CELAENA_SKILL_TEXT_ATHLETICS     "       athletics  (-1)  " 

// DEX skills
#define CELAENA_SKILL_TEXT_ACROBATICS    "      acrobatics  (+3)  " 
#define CELAENA_SKILL_TEXT_SLEIGHT       " sleight of hand  (+3)  " 
#define CELAENA_SKILL_TEXT_STEALTH       "         stealth  (+3)  " 

// INT skills
#define CELAENA_SKILL_TEXT_ARCANA        "          arcana  (+2)  " 
#define CELAENA_SKILL_TEXT_HISTORY       "         history  (+2)  " 
#define CELAENA_SKILL_TEXT_INVESTIGATION "   investigation  (+5)* " // PROF
#define CELAENA_SKILL_TEXT_NATURE        "          nature  (+5)* " // PROF
#define CELAENA_SKILL_TEXT_RELIGION      "        religion  (+2)  " 

// WIS skills
#define CELAENA_SKILL_TEXT_ANIMAL        " animal handling  (+1)  " 
#define CELAENA_SKILL_TEXT_INSIGHT       "         insight  (+1)  " 
#define CELAENA_SKILL_TEXT_MEDICINE      "        medicine  (+1)  " 
#define CELAENA_SKILL_TEXT_PERCEPTION    "      perception  (+4)* " // PROF
#define CELAENA_SKILL_TEXT_SURVIVAL      "        survival  (+1)  " 

// CHA skills
#define CELAENA_SKILL_TEXT_DECEPTION     "       deception  (+7)* " // PROF
#define CELAENA_SKILL_TEXT_INTIMIDATION  "    intimidation  (+4)  " 
#define CELAENA_SKILL_TEXT_PERFORMANCE   "     performance  (+4)  " 
#define CELAENA_SKILL_TEXT_PERSUASION    "      persuasion  (+4)  " 


#define EMBER_CHAR_NAME "  EMBER (lvl 4)  "

#define EMBER_ABILITY_TEXT_STR   "[ 8] STR(-1)" 
#define EMBER_ABILITY_TEXT_DEX   "[16] DEX(+3)" 
#define EMBER_ABILITY_TEXT_CON   "[12] CON(+1)" 
#define EMBER_ABILITY_TEXT_INT   "[17] INT(+3)" 
#define EMBER_ABILITY_TEXT_WIS   "[18] WIS(+4)" 
#define EMBER_ABILITY_TEXT_CHA   "[18] CHA(+4)" 

// STR skills
#define EMBER_SKILL_TEXT_ATHLETICS     "       athletics  (+1)* " // PROF

// DEX skills
#define EMBER_SKILL_TEXT_ACROBATICS    "      acrobatics  (+3)  " 
#define EMBER_SKILL_TEXT_SLEIGHT       " sleight of hand  (+3)  " 
#define EMBER_SKILL_TEXT_STEALTH       "         stealth  (+3)  " 

// INT skills
#define EMBER_SKILL_TEXT_ARCANA        "          arcana  (+5)* " // PROF
#define EMBER_SKILL_TEXT_HISTORY       "         history  (+3)  " 
#define EMBER_SKILL_TEXT_INVESTIGATION "   investigation  (+3)  " 
#define EMBER_SKILL_TEXT_NATURE        "          nature  (+3)  " 
#define EMBER_SKILL_TEXT_RELIGION      "        religion  (+3)  " 

// WIS skills
#define EMBER_SKILL_TEXT_ANIMAL        " animal handling  (+4)  " 
#define EMBER_SKILL_TEXT_INSIGHT       "         insight  (+4)  " 
#define EMBER_SKILL_TEXT_MEDICINE      "        medicine  (+4)  " 
#define EMBER_SKILL_TEXT_PERCEPTION    "      perception  (+6)* " // PROF
#define EMBER_SKILL_TEXT_SURVIVAL      "        survival  (+4)  " 

// CHA skills
#define EMBER_SKILL_TEXT_DECEPTION     "       deception  (+6)* " // PROF
#define EMBER_SKILL_TEXT_INTIMIDATION  "    intimidation  (+4)  " 
#define EMBER_SKILL_TEXT_PERFORMANCE   "     performance  (+4)  " 
#define EMBER_SKILL_TEXT_PERSUASION    "      persuasion  (+4)  " 


void fillGrider(){
  doGrid(&screenInstance,10,10,0,180,30);
  doGrid(&screenInstance,50,50,25,25,100);
  doGrid(&screenInstance,100,100,180,0,0);
}

void setupLCD(){
  // Setup the LCD
  screenInstance.InitLCD();
  screenInstance.setFont(BigFont);

  // Clear the screen and draw the frame
  screenInstance.clrScr();
  // screenInstance.setFont(SmallFont);

  fillGrider();

  // screenInstance.setFont(SmallFont);

  screenInstance.setColor(200,200,200);
}

void setupButtons(){
  // button modes
  pinMode(BUTTON_PIN_UPWARD, INPUT_PULLUP);
  pinMode(BUTTON_PIN_DOWNER, INPUT_PULLUP);
  pinMode(BUTTON_PIN_LEFTER, INPUT_PULLUP);
  pinMode(BUTTON_PIN_RIGHTR, INPUT_PULLUP);

  pinMode(BUTTON_PIN_A, INPUT_PULLUP);
  pinMode(BUTTON_PIN_B, INPUT_PULLUP);
}

void setup()
{
  randomSeed(analogRead(0));
  
  setupLCD();
  setupButtons();
}





void doGrid(UTFT *screenInstance, int xStep, int yStep, unsigned char r, unsigned char g, unsigned char b){
  int x, y;
  int widtherr, heighter;

  if(!screenInstance) return;

  widtherr = SCREEN_WIDTH;
  heighter = SCREEN_HEIGHT;

  // set color
  screenInstance->setColor(r,g,b);

  for(x = xStep-1; x < widtherr; x+=xStep){
    screenInstance->drawLine(x, 0, x, heighter);
  }

  for(y = yStep-1; y < heighter; y+=yStep){
    screenInstance->drawLine(0, y, widtherr, y);
  }
}


void drawSkillsAndAbilities(){
  int i = 0;
  // uint8_t textHeightBig = 16;
  // uint8_t textWidthBig = 16;
  // uint8_t textHeightSmall = 12;
  // uint8_t textWidthSmall = 8;
  // uint8_t charCountAbility = 12;
  // uint8_t charCountSkill = 17;

  #define EMPTYABILITYSTRING "            "
  #define EMPTYSKILLSTRING "                 "
  #define X_MARGIN 1
  #define ABILITYTEXT_HEIGHT 16
  #define ABILITYTEXT_WIDTH 192
  #define SKILLTEXT_HEIGHT 12
  #define SKILLTEXT_WIDTH 204

  #define ABILITYTEXT_X_POS 287 // SCREEN_WIDTH - ABILITYTEXT_WIDTH - XMARGIN
  #define SKILLTEXT_X_POS 287 // SCREEN_WIDTH - SKILLTEXT_WIDTH - XMARGIN

  #define TEXTBORDER_WEIGHT 1

  
  #define TEXT_LEFTBORDER_POS 285 // SCREEN_WIDTH - MAX(ABILITYTEXT_WIDTH,SKILLTEXT_X_POS) - XMARGIN - XMARGIN - TEXTBORDER_WEIGHT

  // BIGTODO maybe look into preprocessor math opers / macros so compile time positiioning with vars

  screenInstance.drawLine(TEXT_LEFTBORDER_POS,0,TEXT_LEFTBORDER_POS,SCREEN_HEIGHT);
  screenInstance.drawLine(479,0,479,SCREEN_HEIGHT);

  screenInstance.drawLine(TEXT_LEFTBORDER_POS,0,SCREEN_WIDTH,0);
  screenInstance.drawLine(TEXT_LEFTBORDER_POS,29,SCREEN_WIDTH,29);
  screenInstance.drawLine(TEXT_LEFTBORDER_POS,82,SCREEN_WIDTH,82);
  screenInstance.drawLine(TEXT_LEFTBORDER_POS,99,SCREEN_WIDTH,99);
  screenInstance.drawLine(TEXT_LEFTBORDER_POS,176,SCREEN_WIDTH,176);
  screenInstance.drawLine(TEXT_LEFTBORDER_POS,253,SCREEN_WIDTH,253);
  screenInstance.drawLine(TEXT_LEFTBORDER_POS,318,SCREEN_WIDTH,318);
  screenInstance.drawLine(TEXT_LEFTBORDER_POS,319,SCREEN_WIDTH,319);

  // screenInstance.setColor()

  screenInstance.setFont(BigFont);

  // ******************************************************************************************************************
  // ******************************************************************************************************************
  // ******************************************************************************************************************

  switch (displayingCharacter)
  {
  case DISPLAYING_CELAENA:
    // ########################################################################
    // ########################################################################
    // NAME
    screenInstance.print(CELAENA_CHAR_NAME,X_MARGIN,1); // 1 PX MARGIN

    // ########################################################################
    // ########################################################################
    break;
  case DISPLAYING_EMBER:
    // ########################################################################
    // ########################################################################
    // NAME
    screenInstance.print(EMBER_CHAR_NAME,X_MARGIN,1); // 1 PX MARGIN

    // ########################################################################
    // ########################################################################
    break;
  
  default:
    break;
  }
  // ******************************************************************************************************************
  // ******************************************************************************************************************
  // ******************************************************************************************************************
  

  // ******************************************************************************************************************
  // ******************************************************************************************************************
  // ******************************************************************************************************************

  switch (displayingCharacter)
  {
  case DISPLAYING_CELAENA:
    // ########################################################################
    // ########################################################################
    // Y: 1
    // STRENGTH
    screenInstance.print(CELAENA_ABILITY_TEXT_STR,ABILITYTEXT_X_POS,1); // 1 PX MARGIN

    // Y: 30
    // DEXERITY
    screenInstance.print(CELAENA_ABILITY_TEXT_DEX,ABILITYTEXT_X_POS,30); // +HEIGHTABILITY(16) +HEIGHTSKILLS(12) +PADDING(1)

    // Y: 83
    // CONSTITUTION
    screenInstance.print(CELAENA_ABILITY_TEXT_CON,ABILITYTEXT_X_POS,83); // +HEIGHTABILITY(16) +HEIGHTSKILLS(3*12) +PADDING(1)
    
    // Y: 100
    // INTELLIGENCE
    screenInstance.print(CELAENA_ABILITY_TEXT_INT,ABILITYTEXT_X_POS,100); // +HEIGHTABILITY(16) +HEIGHTSKILLS(0*12) +PADDING(1)
    
    // Y: 177
    // WISDOM
    screenInstance.print(CELAENA_ABILITY_TEXT_WIS,ABILITYTEXT_X_POS,177); // +HEIGHTABILITY(16) +HEIGHTSKILLS(5*12) +PADDING(1)
    
    // Y: 254
    // CHARISMA
    screenInstance.print(CELAENA_ABILITY_TEXT_CHA,ABILITYTEXT_X_POS,254); // +HEIGHTABILITY(16) +HEIGHTSKILLS(5*12) +PADDING(1)
    // ########################################################################
    // ########################################################################
    break;
  case DISPLAYING_EMBER:
    // ########################################################################
    // ########################################################################
    // Y: 1
    // STRENGTH
    screenInstance.print(EMBER_ABILITY_TEXT_STR,ABILITYTEXT_X_POS,1); // 1 PX MARGIN

    // Y: 30
    // DEXERITY
    screenInstance.print(EMBER_ABILITY_TEXT_DEX,ABILITYTEXT_X_POS,30); // +HEIGHTABILITY(16) +HEIGHTSKILLS(12) +PADDING(1)

    // Y: 83
    // CONSTITUTION
    screenInstance.print(EMBER_ABILITY_TEXT_CON,ABILITYTEXT_X_POS,83); // +HEIGHTABILITY(16) +HEIGHTSKILLS(3*12) +PADDING(1)
    
    // Y: 100
    // INTELLIGENCE
    screenInstance.print(EMBER_ABILITY_TEXT_INT,ABILITYTEXT_X_POS,100); // +HEIGHTABILITY(16) +HEIGHTSKILLS(0*12) +PADDING(1)
    
    // Y: 177
    // WISDOM
    screenInstance.print(EMBER_ABILITY_TEXT_WIS,ABILITYTEXT_X_POS,177); // +HEIGHTABILITY(16) +HEIGHTSKILLS(5*12) +PADDING(1)
    
    // Y: 254
    // CHARISMA
    screenInstance.print(EMBER_ABILITY_TEXT_CHA,ABILITYTEXT_X_POS,254); // +HEIGHTABILITY(16) +HEIGHTSKILLS(5*12) +PADDING(1)
    // ########################################################################
    // ########################################################################
    break;
  
  default:
    break;
  }


  // ******************************************************************************************************************
  // ******************************************************************************************************************
  // ******************************************************************************************************************
  

  // --------------------------------------------------------
  // --------------------------------------------------------

  screenInstance.setFont(SmallFont);


  // ******************************************************************************************************************
  // ******************************************************************************************************************
  // ******************************************************************************************************************

  switch (displayingCharacter)
  {
  case DISPLAYING_CELAENA:
    // ########################################################################
    // ########################################################################
    // Y: 1
    // STRENGTH SKILLS: 1
    // Y: 1 + 16: 17
    screenInstance.print(CELAENA_SKILL_TEXT_ATHLETICS,SKILLTEXT_X_POS,17);

    // Y: 30
    // DEXERITY SKILLS: 3
    // Y: 30 + 16: 46
    screenInstance.print(CELAENA_SKILL_TEXT_ACROBATICS,SKILLTEXT_X_POS,46);
    screenInstance.print(CELAENA_SKILL_TEXT_SLEIGHT,SKILLTEXT_X_POS,58); // 46+12
    screenInstance.print(CELAENA_SKILL_TEXT_STEALTH,SKILLTEXT_X_POS,70); // 46+24

    // Y: 83
    // CONSTITUTION SKILLS: 0
    // Y: 83 + 16: 99
    
    // Y: 100
    // INTELLIGENCE SKILLS: 5
    // Y: 100 + 16: 116
    screenInstance.print(CELAENA_SKILL_TEXT_ARCANA,SKILLTEXT_X_POS,116);
    screenInstance.print(CELAENA_SKILL_TEXT_HISTORY,SKILLTEXT_X_POS,128); // 116+12
    screenInstance.print(CELAENA_SKILL_TEXT_INVESTIGATION,SKILLTEXT_X_POS,140); // 116+24
    screenInstance.print(CELAENA_SKILL_TEXT_NATURE,SKILLTEXT_X_POS,152); // 116+36
    screenInstance.print(CELAENA_SKILL_TEXT_RELIGION,SKILLTEXT_X_POS,164); // 116+48
    
    // Y: 177
    // WISDOM SKILLS: 5
    // Y: 177 + 16: 193
    screenInstance.print(CELAENA_SKILL_TEXT_ANIMAL,SKILLTEXT_X_POS,193);
    screenInstance.print(CELAENA_SKILL_TEXT_INSIGHT,SKILLTEXT_X_POS,205); // 193+12
    screenInstance.print(CELAENA_SKILL_TEXT_MEDICINE,SKILLTEXT_X_POS,217); // 193+24
    screenInstance.print(CELAENA_SKILL_TEXT_PERCEPTION,SKILLTEXT_X_POS,229); // 193+36
    screenInstance.print(CELAENA_SKILL_TEXT_SURVIVAL,SKILLTEXT_X_POS,241); // 193+48
    
    // Y: 254
    // CHARISMA SKILLS: 4
    // Y: 254 + 16: 270
    screenInstance.print(CELAENA_SKILL_TEXT_DECEPTION,SKILLTEXT_X_POS,270);
    screenInstance.print(CELAENA_SKILL_TEXT_INTIMIDATION,SKILLTEXT_X_POS,282); // 270+12
    screenInstance.print(CELAENA_SKILL_TEXT_PERFORMANCE,SKILLTEXT_X_POS,294); // 270+24
    screenInstance.print(CELAENA_SKILL_TEXT_PERSUASION,SKILLTEXT_X_POS,306); // 270+36
    // ########################################################################
    // ########################################################################
    break;
  case DISPLAYING_EMBER:
    // ########################################################################
    // ########################################################################
    // Y: 1
    // STRENGTH SKILLS: 1
    // Y: 1 + 16: 17
    screenInstance.print(EMBER_SKILL_TEXT_ATHLETICS,SKILLTEXT_X_POS,17);

    // Y: 30
    // DEXERITY SKILLS: 3
    // Y: 30 + 16: 46
    screenInstance.print(EMBER_SKILL_TEXT_ACROBATICS,SKILLTEXT_X_POS,46);
    screenInstance.print(EMBER_SKILL_TEXT_SLEIGHT,SKILLTEXT_X_POS,58); // 46+12
    screenInstance.print(EMBER_SKILL_TEXT_STEALTH,SKILLTEXT_X_POS,70); // 46+24

    // Y: 83
    // CONSTITUTION SKILLS: 0
    // Y: 83 + 16: 99
    
    // Y: 100
    // INTELLIGENCE SKILLS: 5
    // Y: 100 + 16: 116
    screenInstance.print(EMBER_SKILL_TEXT_ARCANA,SKILLTEXT_X_POS,116);
    screenInstance.print(EMBER_SKILL_TEXT_HISTORY,SKILLTEXT_X_POS,128); // 116+12
    screenInstance.print(EMBER_SKILL_TEXT_INVESTIGATION,SKILLTEXT_X_POS,140); // 116+24
    screenInstance.print(EMBER_SKILL_TEXT_NATURE,SKILLTEXT_X_POS,152); // 116+36
    screenInstance.print(EMBER_SKILL_TEXT_RELIGION,SKILLTEXT_X_POS,164); // 116+48
    
    // Y: 177
    // WISDOM SKILLS: 5
    // Y: 177 + 16: 193
    screenInstance.print(EMBER_SKILL_TEXT_ANIMAL,SKILLTEXT_X_POS,193);
    screenInstance.print(EMBER_SKILL_TEXT_INSIGHT,SKILLTEXT_X_POS,205); // 193+12
    screenInstance.print(EMBER_SKILL_TEXT_MEDICINE,SKILLTEXT_X_POS,217); // 193+24
    screenInstance.print(EMBER_SKILL_TEXT_PERCEPTION,SKILLTEXT_X_POS,229); // 193+36
    screenInstance.print(EMBER_SKILL_TEXT_SURVIVAL,SKILLTEXT_X_POS,241); // 193+48
    
    // Y: 254
    // CHARISMA SKILLS: 4
    // Y: 254 + 16: 270
    screenInstance.print(EMBER_SKILL_TEXT_DECEPTION,SKILLTEXT_X_POS,270);
    screenInstance.print(EMBER_SKILL_TEXT_INTIMIDATION,SKILLTEXT_X_POS,282); // 270+12
    screenInstance.print(EMBER_SKILL_TEXT_PERFORMANCE,SKILLTEXT_X_POS,294); // 270+24
    screenInstance.print(EMBER_SKILL_TEXT_PERSUASION,SKILLTEXT_X_POS,306); // 270+36
    // ########################################################################
    // ########################################################################
    break;
  
  default:
    break;
  }

  // ******************************************************************************************************************
  // ******************************************************************************************************************
  // ******************************************************************************************************************



  
  // 17 chars for skills
  // 12 for abilities


  // drawSkillList_old();
  // drawAbilityList_old();
  


}

unsigned char asciiValueOfHexDigit(unsigned char input){
  unsigned char boundedInput = input&BITMASK_HALFBYTE_LOWER; // bound it
  return (boundedInput<ASCII_RANGESIZE_DIGIT)? ASCII_RANGESTART_DIGIT+boundedInput : ASCII_RANGESTART_UPPER+boundedInput;
}
unsigned short asciiValueOfByte(unsigned char input){
  unsigned short firstChar = asciiValueOfHexDigit((input&BITMASK_BYTE)>>4);
  unsigned char secondChar = asciiValueOfHexDigit((input&BITMASK_BYTE));
  return (firstChar<<8) + secondChar;
}


void drawFontData(){
  unsigned i = 0;

  unsigned numFontDetails = 4;

  unsigned hexCharPerByte = 2;
  unsigned whitespacePerVal = 1;

  unsigned charArrayOffset = 0;

  unsigned short byteAsciiValue = 0;

  unsigned testStringCharCount = 16;
  char charStringArr[testStringCharCount+1];


  uint8_t fontDetails[] = {
    // make first the should be
    screenInstance.cfont.font[0],
    screenInstance.cfont.font[1],
    // next is what is
    screenInstance.cfont.x_size,
    screenInstance.cfont.y_size
  };


  for(i = 0; i < testStringCharCount; i++){
    charStringArr[i] = ASCII_WHITESPACECHAR;
  }
  charStringArr[testStringCharCount] = 0x00; // give null byte last spot



  // the number of hexes for each byte
  for(i = 0; i < numFontDetails; i++){
    charArrayOffset = i*(hexCharPerByte+whitespacePerVal);
    byteAsciiValue = asciiValueOfByte(fontDetails[i]);

    // left char
    charStringArr[charArrayOffset] = (byteAsciiValue>>8)&BITMASK_BYTE;
    // right char
    charStringArr[charArrayOffset+1] = byteAsciiValue&BITMASK_BYTE;
  }

  screenInstance.print(charStringArr, CENTER, SCREEN_HEIGHT-(TEXT_HEIGHT*2), 0);
}


void doButtonUpdate(){
  if(digitalRead(BUTTON_PIN_UPWARD)==LOW){ mouseY--; }
  if(digitalRead(BUTTON_PIN_DOWNER)==LOW){ mouseY++; }
  if(digitalRead(BUTTON_PIN_LEFTER)==LOW){ mouseX--; }
  if(digitalRead(BUTTON_PIN_RIGHTR)==LOW){ mouseX++; }


  // BIGTODO: have a state cycle
  if(digitalRead(BUTTON_PIN_A)==LOW){
    // mouseMode = MOUSEMODE_DRAW;
    displayingCharacter = DISPLAYING_CELAENA;
  }
  if(digitalRead(BUTTON_PIN_B)==LOW){
    // mouseMode = MOUSEMODE_NONE;
    displayingCharacter = DISPLAYING_EMBER;
  }
  // if(digitalRead(BUTTON_PIN_A)==LOW){ screenInstance.clrScr(); }else{ fillGrider(); }
  // if(digitalRead(BUTTON_PIN_B)==LOW){ screenInstance.clrScr(); }else{ fillGrider(); }
}

void doDrawingUpdate(){


  if(mouseMode==MOUSEMODE_DRAW){
    screenInstance.setColor(200,200,200);
    screenInstance.drawPixel(mouseX,mouseY);
  }
  

}

void loop()
{

  doButtonUpdate();

  doDrawingUpdate();

  drawSkillsAndAbilities();

  drawFontData();
  // rn bc why not
  // delay(LOOP_SNOOZE_TIME);
}

void doDemo(){
  int buf[318];
  int x, x2;
  int y, y2;
  int r;


// Clear the screen and draw the frame
  screenInstance.clrScr();

  screenInstance.setColor(255, 0, 0);
  screenInstance.fillRect(0, 0, 479, 13);
  screenInstance.setColor(64, 64, 64);
  screenInstance.fillRect(0, 306, 479, 319);
  screenInstance.setColor(255, 255, 255);
  screenInstance.setBackColor(255, 0, 0);
  screenInstance.print("* it's a thiinger thinger *", CENTER, 1, 0);
  screenInstance.setBackColor(64, 64, 64);
  screenInstance.setColor(255,255,0);
  screenInstance.print("why would we have a url here", CENTER, 307, 0);

  screenInstance.setColor(0, 0, 255);
  screenInstance.drawRect(0, 14, 479, 305);

// Draw crosshairs
  screenInstance.setColor(0, 0, 255);
  screenInstance.setBackColor(0, 0, 0);
  screenInstance.drawLine(239, 15, 239, 304);
  screenInstance.drawLine(1, 159, 478, 159);
  for (int i=9; i<470; i+=10)
    screenInstance.drawLine(i, 157, i, 161);
  for (int i=19; i<220; i+=10)
    screenInstance.drawLine(237, i, 241, i);

// Draw sin-, cos- and tan-lines  
  screenInstance.setColor(0,255,255);
  screenInstance.print("Sin", 5, 15, 0);
  for (int i=1; i<478; i++)
  {
    screenInstance.drawPixel(i,159+(sin(((i*1.13)*3.14)/180)*95));
  }
  
  screenInstance.setColor(255,0,0);
  screenInstance.print("Cos", 5, 27, 0);
  for (int i=1; i<478; i++)
  {
    screenInstance.drawPixel(i,159+(cos(((i*1.13)*3.14)/180)*95));
  }

  screenInstance.setColor(255,255,0);
  screenInstance.print("Tan", 5, 39, 0);
  for (int i=1; i<478; i++)
  {
    screenInstance.drawPixel(i,159+(tan(((i*1.13)*3.14)/180)));
  }

  delay(2000);

  screenInstance.setColor(0,0,0);
  screenInstance.fillRect(1,15,478,304);
  screenInstance.setColor(0, 0, 255);
  screenInstance.setBackColor(0, 0, 0);
  screenInstance.drawLine(239, 15, 239, 304);
  screenInstance.drawLine(1, 159, 478, 159);

// Draw a moving sinewave
  x=1;
  for (int i=1; i<(478*15); i++) 
  {
    x++;
    if (x==479)
      x=1;
    if (i>479)
    {
      if ((x==239)||(buf[x-1]==159))
        screenInstance.setColor(0,0,255);
      else
        screenInstance.setColor(0,0,0);
      screenInstance.drawPixel(x,buf[x-1]);
    }
    screenInstance.setColor(0,255,255);
    y=159+(sin(((i*0.7)*3.14)/180)*(90-(i / 100)));
    screenInstance.drawPixel(x,y);
    buf[x-1]=y;
  }

  delay(2000);
  
  screenInstance.setColor(0,0,0);
  screenInstance.fillRect(1,15,478,304);

// Draw some filled rectangles
  for (int i=1; i<6; i++)
  {
    switch (i)
    {
      case 1:
        screenInstance.setColor(255,0,255);
        break;
      case 2:
        screenInstance.setColor(255,0,0);
        break;
      case 3:
        screenInstance.setColor(0,255,0);
        break;
      case 4:
        screenInstance.setColor(0,0,255);
        break;
      case 5:
        screenInstance.setColor(255,255,0);
        break;
    }
    screenInstance.fillRect(150+(i*20), 70+(i*20), 210+(i*20), 130+(i*20));
  }

  delay(2000);
  
  screenInstance.setColor(0,0,0);
  screenInstance.fillRect(1,15,478,304);

// Draw some filled, rounded rectangles
  for (int i=1; i<6; i++)
  {
    switch (i)
    {
      case 1:
        screenInstance.setColor(255,0,255);
        break;
      case 2:
        screenInstance.setColor(255,0,0);
        break;
      case 3:
        screenInstance.setColor(0,255,0);
        break;
      case 4:
        screenInstance.setColor(0,0,255);
        break;
      case 5:
        screenInstance.setColor(255,255,0);
        break;
    }
    screenInstance.fillRoundRect(270-(i*20), 70+(i*20), 330-(i*20), 130+(i*20));
  }
  
  delay(2000);
  
  screenInstance.setColor(0,0,0);
  screenInstance.fillRect(1,15,478,304);

// Draw some filled circles
  for (int i=1; i<6; i++)
  {
    switch (i)
    {
      case 1:
        screenInstance.setColor(255,0,255);
        break;
      case 2:
        screenInstance.setColor(255,0,0);
        break;
      case 3:
        screenInstance.setColor(0,255,0);
        break;
      case 4:
        screenInstance.setColor(0,0,255);
        break;
      case 5:
        screenInstance.setColor(255,255,0);
        break;
    }
    screenInstance.fillCircle(180+(i*20),100+(i*20), 30);
  }
  
  delay(2000);
  
  screenInstance.setColor(0,0,0);
  screenInstance.fillRect(1,15,478,304);

// Draw some lines in a pattern
  screenInstance.setColor (255,0,0);
  for (int i=15; i<304; i+=5)
  {
    screenInstance.drawLine(1, i, (i*1.6)-10, 304);
  }
  screenInstance.setColor (255,0,0);
  for (int i=304; i>15; i-=5)
  {
    screenInstance.drawLine(478, i, (i*1.6)-11, 15);
  }
  screenInstance.setColor (0,255,255);
  for (int i=304; i>15; i-=5)
  {
    screenInstance.drawLine(1, i, 491-(i*1.6), 15);
  }
  screenInstance.setColor (0,255,255);
  for (int i=15; i<304; i+=5)
  {
    screenInstance.drawLine(478, i, 490-(i*1.6), 304);
  }
  
  delay(2000);
  
  screenInstance.setColor(0,0,0);
  screenInstance.fillRect(1,15,478,304);

// Draw some random circles
  for (int i=0; i<100; i++)
  {
    screenInstance.setColor(random(255), random(255), random(255));
    x=32+random(416);
    y=45+random(226);
    r=random(30);
    screenInstance.drawCircle(x, y, r);
  }

  delay(2000);
  
  screenInstance.setColor(0,0,0);
  screenInstance.fillRect(1,15,478,304);

// Draw some random rectangles
  for (int i=0; i<100; i++)
  {
    screenInstance.setColor(random(255), random(255), random(255));
    x=2+random(476);
    y=16+random(289);
    x2=2+random(476);
    y2=16+random(289);
    screenInstance.drawRect(x, y, x2, y2);
  }

  delay(2000);
  
  screenInstance.setColor(0,0,0);
  screenInstance.fillRect(1,15,478,304);

// Draw some random rounded rectangles
  for (int i=0; i<100; i++)
  {
    screenInstance.setColor(random(255), random(255), random(255));
    x=2+random(476);
    y=16+random(289);
    x2=2+random(476);
    y2=16+random(289);
    screenInstance.drawRoundRect(x, y, x2, y2);
  }

  delay(2000);
  
  screenInstance.setColor(0,0,0);
  screenInstance.fillRect(1,15,478,304);

  for (int i=0; i<100; i++)
  {
    screenInstance.setColor(random(255), random(255), random(255));
    x=2+random(476);
    y=16+random(289);
    x2=2+random(476);
    y2=16+random(289);
    screenInstance.drawLine(x, y, x2, y2);
  }

  delay(2000);
  
  screenInstance.setColor(0,0,0);
  screenInstance.fillRect(1,15,478,304);

  for (int i=0; i<10000; i++)
  {
    screenInstance.setColor(random(255), random(255), random(255));
    screenInstance.drawPixel(2+random(476), 16+random(289));
  }

  delay(2000);

  screenInstance.fillScr(0, 0, 255);
  screenInstance.setColor(255, 0, 0);
  screenInstance.fillRoundRect(160, 70, 319, 169); 
  
  screenInstance.setColor(255, 255, 255);
  screenInstance.setBackColor(255, 0, 0);
  screenInstance.print("That's it!", CENTER, 93, 0);
  screenInstance.print("Restarting in a", CENTER, 119, 0);
  screenInstance.print("few seconds...", CENTER, 132, 0);
  
  screenInstance.setColor(0, 255, 0);
  screenInstance.setBackColor(0, 0, 255);
  screenInstance.print("Runtime: (msecs)", CENTER, 290, 0);
  screenInstance.printNumI(millis(), CENTER, 305);
  
  delay (10000);
}